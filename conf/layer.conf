## conf/layer.conf
```bitbake
# We have a conf and classes directory, add to BBPATH
BBPATH .= ":${LAYERDIR}"

INHERIT += "rm_work"

# We have recipes-* directories, add to BBFILES
BBFILES += "${LAYERDIR}/recipes-*/*/*.bb \
            ${LAYERDIR}/recipes-*/*/*.bbappend"

BBFILE_COLLECTIONS += "meta-ggc-som-mx6"
BBFILE_PATTERN_meta-ggc-som-mx6 = "^${LAYERDIR}/"
BBFILE_PRIORITY_meta-ggc-som-mx6 = "66"


LAYERSERIES_COMPAT_variscite-imx = "sumo"
LAYERSERIES_COMPAT_meta-ggc-som-mx6 = "sumo"

LAYERSERIES_COMPAT_fsl-arm-extra = "sumo"
LAYERDEPENDS_meta-ggc-som-mx6 = "core variscite-imx"
```

## conf/machine/ggc-som-mx6.conf
```bitbake
#@TYPE: Machine
#@NAME: Variscite VAR-SOM-MX6
#@SOC: i.MX6Q/D/DL/S
#@DESCRIPTION: Machine configuration for Variscite VAR-SOM-MX6 VAR-SOM-SOLO/DUAL DART-MX6
#@MAINTAINER: Eran Matityahu <eran.m@variscite.com>
#
# http://www.variscite.com

require conf/machine/var-som-mx6.conf

#MACHINEOVERRIDES =. "mx6:mx6dl:mx6q:"
```
